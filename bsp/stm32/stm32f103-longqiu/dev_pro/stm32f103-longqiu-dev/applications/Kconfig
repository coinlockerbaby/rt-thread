## bsp/stm32/stm32f103-longqiu/dev_pro/stm32f103-longqiu-dev/applications/Kconfig
```kconfig
menu "Robot Config"

menu "Applications Config"
    config USING_KERNEL_SAMPLE
        bool "Enable Kernel Sample"
        default n
    config USING_DEVICE_SAMPLE
        bool "Enable Device Sample"
        default n
    config USING_MOTOR_SAMPLE
        bool "Enable Motor Sample"
        default n
    config USING_MOTOR_SPTA
        bool "Enable Motor SPTA"
        default n
endmenu

menu "Robot Drivers"
    config BSP_USING_MOTOR
    bool "Enable Motor Driver"
    default n
endmenu

endmenu
```

## bsp/stm32/stm32f103-longqiu/dev_pro/stm32f103-longqiu-dev/board/Kconfig
```kconfig
menu "Hardware Drivers Config"

config SOC_STM32F103ZE
    bool
    select SOC_SERIES_STM32F1
    select RT_USING_COMPONENTS_INIT
    select RT_USING_USER_MAIN
    default y

menu "Onboard Peripheral Drivers"
    config BSP_USING_KEY
            bool "Enable onboard KEYS"
            select RT_USING_PIN
            select RT_USING_TIMER_SOFT
            select PKG_USING_FLEXIBLE_BUTTON
            default n
endmenu

menu "On-chip Peripheral Drivers"

    config BSP_USING_GPIO
        bool "Enable GPIO"
        select RT_USING_PIN
        default y

    menuconfig BSP_USING_UART
        bool "Enable UART"
        default y
        select RT_USING_SERIAL
        if BSP_USING_UART
            config BSP_USING_UART1
                bool "Enable UART1"
                default y

            config BSP_UART1_RX_USING_DMA
                bool "Enable UART1 RX DMA"
                depends on BSP_USING_UART1 && RT_SERIAL_USING_DMA
                default n

            config BSP_USING_UART2
                            bool "Enable UART2"
                            default y

            config BSP_UART2_RX_USING_DMA
                bool "Enable UART2 RX DMA"
                depends on BSP_USING_UART2 && RT_SERIAL_USING_DMA
                default n
        endif
    source "libraries/HAL_Drivers/Kconfig"

    menuconfig BSP_USING_TIM
        bool "Enable timer"
        default n
        select RT_USING_HWTIMER
        if BSP_USING_TIM
            config BSP_USING_TIM2
                bool "Enable TIM2"
                default n

            config BSP_USING_TIM3
                bool "Enable TIM3"
                default n

            config BSP_USING_TIM4
                bool "Enable TIM4"
                default n
        endif

    menuconfig BSP_USING_PWM
        bool "Enable PWM"
        default n
        select RT_USING_PWM
        if BSP_USING_PWM
        menuconfig BSP_USING_PWM3
            bool "Enable timer3 output PWM"
            default n
            if BSP_USING_PWM3
                config BSP_USING_PWM3_CH1
                    bool "Enable PWM3 channel1"
                    default n

                config BSP_USING_PWM3_CH2
                    bool "Enable PWM3 channel2"
                    default n
            endif
        endif


endmenu

menu "Board extended module Drivers"

endmenu

endmenu
```
